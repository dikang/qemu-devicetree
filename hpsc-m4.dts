/*
 * ZynqMP PMU device tree for multi-arch
 *
 * Copyright (c) 2016, Xilinx Inc
 * All rights reserved.
 *
 * Redistribution and use in source and binary forms, with or without
 * modification, are permitted provided that the following conditions are met:
 *     * Redistributions of source code must retain the above copyright
 *       notice, this list of conditions and the following disclaimer.
 *     * Redistributions in binary form must reproduce the above copyright
 *       notice, this list of conditions and the following disclaimer in the
 *       documentation and/or other materials provided with the distribution.
 *     * Neither the name of the <organization> nor the
 *       names of its contributors may be used to endorse or promote products
 *       derived from this software without specific prior written permission.
 *
 * THIS SOFTWARE IS PROVIDED BY THE COPYRIGHT HOLDERS AND CONTRIBUTORS "AS IS" AND
 * ANY EXPRESS OR IMPLIED WARRANTIES, INCLUDING, BUT NOT LIMITED TO, THE IMPLIED
 * WARRANTIES OF MERCHANTABILITY AND FITNESS FOR A PARTICULAR PURPOSE ARE
 * DISCLAIMED. IN NO EVENT SHALL <COPYRIGHT HOLDER> BE LIABLE FOR ANY
 * DIRECT, INDIRECT, INCIDENTAL, SPECIAL, EXEMPLARY, OR CONSEQUENTIAL DAMAGES
 * (INCLUDING, BUT NOT LIMITED TO, PROCUREMENT OF SUBSTITUTE GOODS OR SERVICES;
 * LOSS OF USE, DATA, OR PROFITS; OR BUSINESS INTERRUPTION) HOWEVER CAUSED AND
 * ON ANY THEORY OF LIABILITY, WHETHER IN CONTRACT, STRICT LIABILITY, OR TORT
 * (INCLUDING NEGLIGENCE OR OTHERWISE) ARISING IN ANY WAY OUT OF THE USE OF THIS
 * SOFTWARE, EVEN IF ADVISED OF THE POSSIBILITY OF SUCH DAMAGE.
 */

#include "hpsc-m4.dtsh"

/dts-v1/;

/ {
	#address-cells = <MEMORY_ADDRESS_CELLS>;
	#size-cells = <1>;
	cpus {
		#address-cells = <1>;
		#cpus = <0x1>;
		#size-cells = <0>;
		pmu_cpu0: cpu@0 {
			#interrupt-cells = <1>;
			clock-frequency = <100000000>;
			d-cache-line-size = <0x20>;			
			d-cache-size = <0x1000>;			
			compatible = "cortex-m4-arm-cpu";
			device_type = "cpu";
			i-cache-line-size = <0x20>;		
			i-cache-size = <0x200>;
			arm,midr = <0x410fc240>;
			arm,ctr = <0x83338003>;
			arm,clidr = <0x09200003>;
			arm,id_pfr0 = <0x30>;
			arm,ccsidr1 = <0x24770011>;
			reg = <0>;
			timebase-frequency = <100000000>;
#ifdef MULTI_ARCH
			gpios = <&rp_gpio_pmu 0 &rp_gpio_pmu 3>;
			gpio-names = "wakeup", "mb_sleep";
#endif
			mr = <&lmb_pmu>;
			memory = <&lmb_pmu>;
			memattr = <&pmu_memattr>;
		};
	};

	lmb_pmu: lmb_pmu@0 {
		#address-cells = <MEMORY_ADDRESS_CELLS>;
		#size-cells = <2>;
		#priority-cells = <1>;
		compatible = "simple-bus";
		ranges;

		main_bus_for_pmu {
			compatible = "qemu:memory-region";
			alias = <&amba>;
			/* Full address range with -1 priority */
			reg = <0x0 0x0 0xffffffff 0xffffffff 0xffffffff>;
		};

		/* PMU ROM. 32K.  */
/*
		pmu_rom: memory@ffd00000 {
			device_type = "memory";
			reg = <BASE_ADDR(0xffd00000) 0x0 0x00008000 0x1>;
			compatible = "qemu:memory-region";
			container = <&lmb_pmu>;
			qemu,ram = <1>;
			read-only;
		};
*/
#ifdef MULTI_ARCH
		rp_memory_master: rp_mm@40000000 {
			compatible = "remote-port-memory-master";
			remote-ports = <&pmu 0>;
			reg = <BASE_ADDR(0x40000000) 0x0 0xc0000000 0xfffffffe>;
		};
#endif
	};

#ifdef MULTI_ARCH
	pmu: pmu@0 {
		compatible = "remote-port";
		chrdev-id = "pmu-apu-rp";
	};

	rp_gpio_mpu_intr: rp_gpio_pmu_intr@0 {
		compatible = "remote-port-gpio";
		remote-ports = <&pmu 1>;
		num-gpios = <1>;
		interrupts-extended = <&pmu_cpu0 0>;
	};
	rp_gpio_pmu: rp_gpio_pmu@0 {
		#gpio-cells = <1>;
		compatible = "remote-port-gpio";
		remote-ports = <&pmu 2>;
		gpio-controller;
		num-gpios = <4>;
	};

	ps_reset@0 {
		compatible = "qemu,reset-device";
		gpios = <&rp_gpio_pmu 1
				 &rp_gpio_pmu 2>;
	};
#endif
	MEM_REGION(ddr_bank1_1, 0x0, 0x0, 0x0, 0x30000, &ddr3_ram)
	MEM_REGION(ddr_bank1_2, 0x0, 0x30000, 0x30000, 0x10000, &ddr3_ram)
	MEM_REGION(ddr_bank1_3, 0x0, 0x40000, 0x40000, 0x3FFC0000, &ddr3_ram)
	MEM_REGION(ddr_bank2, 0x0, 0x40000000, 0x40000000, 0x40000000, &ddr3_ram)
};

#include "hpsc-memory-regions.dtsi"

#ifndef MULTI_ARCH
/ {
	gic: dummy_gic@0 {
		#interrupt-cells = <3>;
		interrupt-controller ;
	};
};

#include "hpsc-pmu-dev.dtsi"
#include "hpsc-iou.dtsi"
#endif
